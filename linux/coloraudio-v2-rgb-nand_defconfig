## linux/rockchip_coloraudio_rk3506_buildroot_defconfig
```kconfig
#include "base/base.config"
#include "chips/rk3506_arm.config"
#include "fs/vfat.config"
#include "wifibt/bt.config"
#include "wifibt/wireless.config"
#include "multimedia/audio.config"
#include "wifibt/bt.config"
#include "wifibt/wireless.config"
#include "lvgl/v9/lvgl_rkadk.config"
#include "lvgl/v9/rk_demo.config"
#include "fs/ntfs.config"
# BR2_PACKAGE_CHRONY is reset to default
# BR2_PACKAGE_DNSMASQ is reset to default
# BR2_PACKAGE_DROPBEAR is reset to default
BR2_PACKAGE_EVTEST=y
BR2_PACKAGE_HOST_LINUX_HEADERS_CUSTOM_6_1=y
BR2_PACKAGE_LIBCAP=y
BR2_PACKAGE_MHZ=y
BR2_PACKAGE_MTD=y
# BR2_PACKAGE_PULSEAUDIO is reset to default
BR2_PACKAGE_RIPGREP=y
BR2_PACKAGE_RKADK_EXAMPLES=y
BR2_PACKAGE_ROCKCHIP_RGA=y
BR2_PACKAGE_ROCKCHIP_TEST=y
BR2_RK_DEMO_ENABLE_ASR=y
BR2_ROCKCHIP_ALSA_CONFIG_INSTALL_INIT_SCRIPT=y
BR2_ROOTFS_OVERLAY+="board/rockchip/rk3506/fast-display-overlay/"
BR2_ROOTFS_POST_BUILD_SCRIPT+="board/rockchip/rk3506/post-build-fast-display.sh"
# BR2_TARGET_GENERIC_REMOUNT_ROOTFS_RW is not set
BR2_TARGET_ROOTFS_SQUASHFS4_ZSTD=y
BR2_TARGET_ROOTFS_UBI=y
#BR2_TARGET_ROOTFS_UBI_SQUASHFS=y
# BR2_TARGET_ROOTFS_UBI_SQUASHFS_STATIC is not set
BR2_TARGET_ROOTFS_UBIFS_LEBSIZE=0x1F000
BR2_TARGET_ROOTFS_UBIFS_MAXLEBCNT=1024
BR2_TARGET_ROOTFS_UBIFS_OPTS="-F -v"
BR2_TARGET_ROOTFS_UBI_SUBSIZE=2048
BR2_TIME_BITS_64=y
BR2_PACKAGE_RECOVERY=y
BR2_PACKAGE_RECOVERY_NO_UI=y
BR2_PACKAGE_RECOVERY_USE_UPDATEENGINE=y
BR2_PACKAGE_RECOVERY_UPDATEENGINEBIN=y
#stress
BR2_PACKAGE_STRESS=y
#iperf3
BR2_PACKAGE_IPERF3=y
#iptables
BR2_PACKAGE_IPTABLES=y
#ssh
BR2_PACKAGE_OPENSSH=y
#lib gpiod
BR2_PACKAGE_LIBGPIOD=y
BR2_PACKAGE_LIBGPIOD_TOOLS=y
#can
BR2_PACKAGE_CAN_UTILS=y
#local time
BR2_TARGET_LOCALTIME="Asia/Shanghai"
#ntp
BR2_PACKAGE_NTP=y
BR2_PACKAGE_NTP_NTPDATE=y
#iproute2
BR2_PACKAGE_IPROUTE2=y
#pcre2
BR2_PACKAGE_PCRE2=y
BR2_PACKAGE_PCRE2_16=y
BR2_PACKAGE_PCRE2_32=y
```

## linux/rockchip_rk3506_coloraudio_buildroot_defconfig
```kconfig
#include "base/base.config"
#include "fs/vfat.config"
#include "wifibt/bt.config"
#include "wifibt/wireless.config"
#include "multimedia/audio.config"
#include "fs/ntfs.config"
BR2_PACKAGE_BLUEZ_TOOLS=y
# BR2_PACKAGE_CHRONY is reset to default
BR2_PACKAGE_CRDA=y
BR2_PACKAGE_DHRYSTONE=y
# BR2_PACKAGE_DNSMASQ is reset to default
# BR2_PACKAGE_DROPBEAR is reset to default
BR2_PACKAGE_LIBEVDEV=y
BR2_PACKAGE_EVTEST=y
BR2_PACKAGE_FLAC=y
BR2_PACKAGE_FREETYPE=y
BR2_PACKAGE_HOST_LINUX_HEADERS_CUSTOM_6_1=y
BR2_PACKAGE_IPERF=y
BR2_PACKAGE_IPERF3=y
BR2_PACKAGE_IPROUTE2=y
BR2_PACKAGE_IPTABLES=y
BR2_PACKAGE_LIBCAP=y
BR2_PACKAGE_LIBGPIOD=y
BR2_PACKAGE_LIBGPIOD_TOOLS=y
BR2_PACKAGE_LIBID3TAG=y
BR2_PACKAGE_LIBOGG=y
BR2_PACKAGE_LIBSVG=y
BR2_PACKAGE_MEMTESTER=y
BR2_PACKAGE_MHZ=y
BR2_PACKAGE_MTD=y
BR2_PACKAGE_NTP=y
BR2_PACKAGE_NTP_NTPDATE=y
BR2_PACKAGE_OPENSSH=y
BR2_PACKAGE_PCRE2_16=y
BR2_PACKAGE_PCRE2_32=y
# BR2_PACKAGE_PULSEAUDIO is reset to default
BR2_PACKAGE_RECOVERY=y
BR2_PACKAGE_RECOVERY_NO_UI=y
BR2_PACKAGE_RECOVERY_USE_UPDATEENGINE=y
BR2_PACKAGE_RIPGREP=y
BR2_PACKAGE_RK3506=y
BR2_PACKAGE_RKADK=y
BR2_PACKAGE_RKADK_DISPLAY=y
BR2_PACKAGE_RKADK_PLAYER=y
BR2_PACKAGE_ROCKCHIP_RGA=y
BR2_PACKAGE_SDL2=y
BR2_PACKAGE_SDL2_IMAGE=y
BR2_PACKAGE_SDL2_MIXER=y
BR2_PACKAGE_SOX=y
BR2_PACKAGE_WEBP=y
BR2_ROCKCHIP_ALSA_CONFIG_INSTALL_INIT_SCRIPT=y
BR2_ROOTFS_OVERLAY+="board/rockchip/rk3506/fast-display-overlay/"
BR2_ROOTFS_POST_BUILD_SCRIPT+="board/rockchip/rk3506/post-build-fast-display.sh"
BR2_TARGET_GENERIC_HOSTNAME="rk3506"
BR2_TARGET_GENERIC_ISSUE="Welcome to RK3506 Buildroot"
# BR2_TARGET_GENERIC_REMOUNT_ROOTFS_RW is not set
BR2_TARGET_LOCALTIME="Asia/Shanghai"
BR2_TARGET_ROOTFS_SQUASHFS4_ZSTD=y
BR2_TARGET_ROOTFS_UBI=y
BR2_TARGET_ROOTFS_UBIFS_LEBSIZE=0x1F000
BR2_TARGET_ROOTFS_UBIFS_LZO=y
BR2_TARGET_ROOTFS_UBIFS_OPTS="-F -v"
BR2_TARGET_ROOTFS_UBI_SUBSIZE=2048
BR2_TIME_BITS_64=y
BR2_arm=y
BR2_cortex_a7=y
```
